## sdkconfig.defaults
```kconfig
# BLE配网所需配置
CONFIG_BT_ENABLED=y
CONFIG_BT_NIMBLE_ENABLED=y

# WiFi Provisioning Manager
CONFIG_WIFI_PROV_SCAN_MAX_ENTRIES=16
CONFIG_WIFI_PROV_AUTOSTOP_TIMEOUT=30

# 分区表使用默认（需包含NVS分区）
CONFIG_PARTITION_TABLE_SINGLE_APP=y

# 看门狗超时配置（ESP32-C3单核, WiFi+BLE初始化耗时较长）
CONFIG_ESP_INT_WDT_TIMEOUT_MS=800
CONFIG_ESP_TASK_WDT_TIMEOUT_S=10
```
